## buildroot-2024.08.2/package/custom_payload/Config.in
```kconfig
config BR2_PACKAGE_CUSTOM_PAYLOAD
    bool "Custom Payload"
    help
      This package installs a custom payload (reverse_shell.elf) into the target root filesystem.
```

## custom_payload/Config.in
```kconfig
config BR2_PACKAGE_CUSTOM_PAYLOAD
    bool "Custom Payload"
    help
      This adds a custom reverse shell payload to the target image.
```
